## schema/sample.yaml
```yaml
sample:
  type: array
  items:
    type: object
    properties:
      sample_id:
        type: string
        maxLength: 40
      active_ind:
        type: string
        maxLength: 1
      base_md:
        type: number
        format: decimal
      base_md_ouom:
        type: string
        maxLength: 40
      base_strat_unit_id:
        type: string
        maxLength: 40
      collected_by_ba_id:
        type: string
        maxLength: 40
      collected_date:
        type: string
      collected_equip_id:
        type: string
        maxLength: 40
      collected_for_ba_id:
        type: string
        maxLength: 40
      collected_time:
        type: string
      collection_phase_type:
        type: string
        maxLength: 40
      collection_press:
        type: number
        format: decimal
      collection_press_ouom:
        type: string
        maxLength: 40
      collection_temp:
        type: number
        format: decimal
      collection_temp_ouom:
        type: string
        maxLength: 40
      collection_test_type:
        type: string
        maxLength: 40
      collection_type:
        type: string
        maxLength: 40
      composite_sample_count:
        type: integer
      composite_sample_ind:
        type: string
        maxLength: 1
      condensed_section_ind:
        type: string
        maxLength: 1
      current_length:
        type: number
        format: decimal
      current_length_ouom:
        type: string
        maxLength: 40
      current_length_percent:
        type: number
        format: decimal
      current_volume:
        type: number
        format: decimal
      current_volume_ouom:
        type: string
        maxLength: 40
      current_volume_percent:
        type: number
        format: decimal
      current_weight:
        type: number
        format: decimal
      current_weight_ouom:
        type: string
        maxLength: 40
      current_weight_percent:
        type: number
        format: decimal
      cylinder_press:
        type: number
        format: decimal
      cylinder_press_ouom:
        type: string
        maxLength: 40
      cylinder_temp:
        type: number
        format: decimal
      cylinder_temp_ouom:
        type: string
        maxLength: 40
      destroyed_date:
        type: string
      effective_date:
        type: string
      expiry_date:
        type: string
      initial_length:
        type: number
        format: decimal
      initial_length_ouom:
        type: string
        maxLength: 40
      initial_length_percent:
        type: number
        format: decimal
      initial_volume:
        type: number
        format: decimal
      initial_volume_ouom:
        type: string
        maxLength: 40
      initial_volume_percent:
        type: number
        format: decimal
      initial_weight:
        type: number
        format: decimal
      initial_weight_ouom:
        type: string
        maxLength: 40
      initial_weight_percent:
        type: number
        format: decimal
      interval_percent:
        type: number
        format: decimal
      oil_stained_ind:
        type: string
        maxLength: 1
      physical_item_id:
        type: string
        maxLength: 40
      ppdm_guid:
        type: string
        maxLength: 38
      remark:
        type: string
        maxLength: 2000
      reported_mud_desc:
        type: string
        maxLength: 240
      reported_res_press:
        type: number
        format: decimal
      reported_res_press_ouom:
        type: string
        maxLength: 40
      sample_count:
        type: integer
      sample_diameter:
        type: number
        format: decimal
      sample_diameter_ouom:
        type: string
        maxLength: 40
      sample_interval:
        type: number
        format: decimal
      sample_interval_ouom:
        type: integer
      sample_quality:
        type: string
        maxLength: 40
      sample_quality_desc:
        type: string
        maxLength: 1024
      sample_ref_num:
        type: string
        maxLength: 255
      sample_shape_type:
        type: string
        maxLength: 40
      sample_type:
        type: string
        maxLength: 40
      sample_width:
        type: number
        format: decimal
      sample_width_ouom:
        type: string
        maxLength: 40
      separator_press:
        type: number
        format: decimal
      separator_press_ouom:
        type: string
        maxLength: 40
      separator_temp:
        type: number
        format: decimal
      separator_temp_ouom:
        type: string
        maxLength: 40
      source:
        type: string
        maxLength: 40
      stored_equip_id:
        type: string
        maxLength: 40
      stored_phase_type:
        type: string
        maxLength: 40
      strat_name_set_id:
        type: string
        maxLength: 40
      sub_sample_ind:
        type: string
        maxLength: 1
      top_md:
        type: number
        format: decimal
      top_md_ouom:
        type: string
        maxLength: 40
      top_strat_unit_id:
        type: string
        maxLength: 40
      total_length:
        type: number
        format: decimal
      total_length_ouom:
        type: string
        maxLength: 40
      total_volume:
        type: number
        format: decimal
      total_volume_ouom:
        type: string
        maxLength: 40
      total_weight:
        type: number
        format: decimal
      total_weight_ouom:
        type: string
        maxLength: 40
      well_datum_type:
        type: string
        maxLength: 40
      row_changed_by:
        type: string
        maxLength: 30
      row_changed_date:
        type: string
      row_created_by:
        type: string
        maxLength: 30
      row_created_date:
        type: string
      row_effective_date:
        type: string
      row_expiry_date:
        type: string
      row_quality:
        type: string
        maxLength: 40
```
